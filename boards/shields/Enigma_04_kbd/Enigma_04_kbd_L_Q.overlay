#include "Enigma_04_kbd_L.overlay"

&kscan_kbd0 {
    col-gpios = <&gpio1 11 GPIO_ACTIVE_HIGH>,
          <&gpio0 5 GPIO_ACTIVE_HIGH>,
          <&gpio0 4 GPIO_ACTIVE_HIGH>,
          <&gpio0 29 GPIO_ACTIVE_HIGH>,
          <&gpio0 28 GPIO_ACTIVE_HIGH>;
};

&kscan_kbd1 {
    gpios = <&gpio1 15 GPIO_ACTIVE_HIGH>,
        <&gpio1 12 GPIO_ACTIVE_HIGH>,
        <&gpio0 9 GPIO_ACTIVE_HIGH>,
        <&gpio0 10 GPIO_ACTIVE_HIGH>,
        <&gpio0 29 GPIO_ACTIVE_HIGH>;
};
