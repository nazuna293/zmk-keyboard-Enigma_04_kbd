#include "Enigma_04_kbd_R.overlay"

&transform_kbd0 {
    col-offset = <5>;
};

&kscan_kbd0 {
    col-gpios = <&gpio1 11 GPIO_ACTIVE_HIGH>,
          <&gpio0 5 GPIO_ACTIVE_HIGH>,
          <&gpio0 4 GPIO_ACTIVE_HIGH>,
          <&gpio0 29 GPIO_ACTIVE_HIGH>,
          <&gpio0 28 GPIO_ACTIVE_HIGH>;
};

&transform_kbd1 {
    col-offset = <5>;
};

&kscan_kbd1 {
    gpios = <&gpio1 15 GPIO_ACTIVE_HIGH>,
        <&gpio1 12 GPIO_ACTIVE_HIGH>,
        <&gpio0 9 GPIO_ACTIVE_HIGH>,
        <&gpio0 10 GPIO_ACTIVE_HIGH>,
        <&gpio0 29 GPIO_ACTIVE_HIGH>;
};
