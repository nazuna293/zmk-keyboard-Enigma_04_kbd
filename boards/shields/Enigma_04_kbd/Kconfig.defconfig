## boards/shields/Enigma_04_kbd/Kconfig.defconfig
```kconfig
if SHIELD_Enigma_04_kbd_L

config ZMK_KEYBOARD_NAME
    default "Enigma_04_kbd"

config ZMK_USB
	  default y

config ZMK_BLE
    default y

config ZMK_SPLIT_ROLE_CENTRAL
    default y

endif

if SHIELD_Enigma_04_kbd_L || SHIELD_Enigma_04_kbd_R
config NFCT_PINS_AS_GPIOS
    default y

config ZMK_SPLIT
    default y

endif
```

## boards/shields/Enigma_04_kbd/Kconfig.shield
```kconfig
config SHIELD_Enigma_04_kbd_L
    def_bool $(shields_list_contains,Enigma_04_kbd_L)

config SHIELD_Enigma_04_kbd_R
    def_bool $(shields_list_contains,Enigma_04_kbd_R)

config SHIELD_Enigma_04_kbd_L_O
    def_bool $(shields_list_contains,Enigma_04_kbd_L_O)

config SHIELD_Enigma_04_kbd_R_O
    def_bool $(shields_list_contains,Enigma_04_kbd_R_O)

config SHIELD_Enigma_04_kbd_L_Q
    def_bool $(shields_list_contains,Enigma_04_kbd_L_Q)

config SHIELD_Enigma_04_kbd_R_Q
    def_bool $(shields_list_contains,Enigma_04_kbd_R_Q)
```
